## boards/shields/komoji/Kconfig.defconfig
```kconfig
if SHIELD_KOMOJI_LEFT

config ZMK_KEYBOARD_NAME
    default "komoji"

config ZMK_SPLIT_ROLE_CENTRAL
    default y

endif

if SHIELD_KOMOJI_LEFT || SHIELD_KOMOJI_RIGHT

config ZMK_SPLIT
    default y

endif
```

## boards/shields/komoji/Kconfig.shield
```kconfig
# Copyright (c) 2020 Pete Johanson
# SPDX-License-Identifier: MIT

config SHIELD_KOMOJI_LEFT
    def_bool $(shields_list_contains,komoji_left)

config SHIELD_KOMOJI_RIGHT
    def_bool $(shields_list_contains,komoji_right)
```

## config/west.yml
```yaml
manifest:
  remotes:
    - name: zmkfirmware
      url-base: https://github.com/zmkfirmware
    - name: m165437
      url-base: https://github.com/M165437 
    - name: whoop-t 
      url-base: https://github.com/whoop-t 
  projects:
    - name: zmk
      remote: zmkfirmware
      revision: main
      import: app/west.yml
    - name: nice-view-gem 
      remote: m165437 
      revision: main 
    - name: nice-luffy-wanted 
      remote: whoop-t 
      revision: main 
  self:
    path: config
```
